/*
 * This software is contributed or developed by KYOCERA Corporation.
 * (C) 2013 KYOCERA Corporation
 */
/*
 * This program is free software; you can redistribute it and/or modify
 * it under the terms of the GNU General Public License version 2 and
 * only version 2 as published by the Free Software Foundation.
 *
 * This program is distributed in the hope that it will be useful,
 * but WITHOUT ANY WARRANTY; without even the implied warranty of
 * MERCHANTABILITY or FITNESS FOR A PARTICULAR PURPOSE.  See the
 * GNU General Public License for more details.
 *
 * You should have received a copy of the GNU General Public License
 * along with this program; if not, write to the Free Software
 * Foundation, Inc., 51 Franklin Street, Fifth Floor, Boston, MA  02110-1301, USA.
 *
 */

&soc {

	qcom,mdss_dsi_sharp_1080p_video {
		compatible = "qcom,mdss-dsi-panel";
		label = "sharp 1080p video mode dsi panel";
		status = "disable";
		qcom,dsi-ctrl-phandle = <&mdss_dsi0>;
		qcom,enable-gpio = <&msmgpio 58 0>;
		qcom,rst-gpio = <&pm8941_gpios 19 0>;
		qcom,vmipi_18_en-gpio = <&msmgpio 11 0>;
		qcom,mdss-pan-res = <1080 1920>;
		qcom,mdss-pan-bpp = <24>;
		qcom,mdss-pan-dest = "display_1";
		qcom,mdss-pan-porch-values = <50 10 106 8 2 3>;
		qcom,mdss-pan-underflow-clr = <0xff>;
		qcom,mdss-pan-bl-ctrl = "bl_ctrl_wled";
		qcom,mdss-pan-bl-levels = <1 4095>;
		qcom,mdss-pan-dsi-mode = <0>;
		qcom,mdss-pan-dsi-h-pulse-mode = <0>;
		qcom,mdss-pan-dsi-h-power-stop = <0 0 0>; /* HBP,HSA,HFP */
		qcom,mdss-pan-dsi-bllp-power-stop = <1 1>;
		qcom,mdss-pan-dsi-traffic-mode = <1>;
		qcom,mdss-pan-dsi-dst-format = <3>;
		qcom,mdss-pan-dsi-vc = <0>;
		qcom,mdss-pan-dsi-rgb-swap = <0>;
		qcom,mdss-pan-dsi-data-lanes = <1 1 1 1>;
		qcom,mdss-pan-dsi-dlane-swap = <0>;
		qcom,mdss-pan-dsi-t-clk = <0x36 0x1e>; /* pre,post*/
		qcom,mdss-pan-dsi-stream = <0>;
		qcom,mdss-pan-dsi-mdp-tr = <0x04>;
		qcom,mdss-pan-dsi-dma-tr = <0x04>;
		qcom,mdss-pan-dsi-frame-rate = <60>;
		qcom,mdss-dsi-pan-enable-dynamic-fps;
		qcom,mdss-dsi-pan-fps-update = "dfps_suspend_resume_mode";
		qcom,panel-phy-regulatorSettings = [07 09 03 00  /* Regualotor settings */
						    20 00 01];
		qcom,panel-phy-timingSettings = [f6 44 38 00 5e e8
						    3a 46 58 03 04 00];
		qcom,panel-phy-strengthCtrl = [ff 06];
		qcom,panel-phy-bistCtrl = [00 00 b1 ff           /* BIST Ctrl settings */
					   00 00];
		qcom,panel-phy-laneConfig = [00 00 00 00 00 00 00 01 97 /* lane0 config */
					     00 00 00 00 05 00 00 01 97 /* lane1 config */
					     00 00 00 00 0a 00 00 01 97 /* lane2 config */
					     00 00 00 00 0f 00 00 01 97 /* lane3 config */
					     00 c0 00 00 00 00 00 01 bb]; /* Clk ln config */

		qcom,panel-on-cmds = [
					23 01 00 00 00 00 02 b0 00          /* Manufacture Command Access Protect */
					05 01 00 00 00 00 01 00             /* nop */
					05 01 00 00 00 00 01 00             /* nop */
					23 01 00 00 00 00 02 d6 01

					/* Reg(1) */
					29 01 00 00 00 00 07                /* Interface setting */
						b3 14 00 00 00 00 00
					29 01 00 00 00 00 03                /* Interface ID setting */
						b4 0c 00
					29 01 00 00 00 00 03                /* DSI Control */
						b6 3a d3
					29 01 00 00 00 00 03                /* External Clock Setting */
						bb 00 10
					29 01 00 00 00 00 03                /* Slew rate adjustment */
						c0 00 00
					29 01 00 00 00 00 23                /* Display Setting1common */
						c1 04 60 00 40 10 00 50 02 00
						00 00 5c 63 ac 39 00 00 50 01
						00 00 ca 00 00 00 00 00 00 00
						00 02 02 02 00
					29 01 00 00 00 00 08                /* Display Setting2 */
						c2 32 f7 80 0a 08 00 00
					29 01 00 00 00 00 04                /* TPC Sync Control */
						c3 00 00 00
					29 01 00 00 00 00 17                /* Source Timing Setting */
						c4 70 00 00 05 00 05 00 00 00
						00 09 00 00 00 05 00 05 00 00
						00 00 09
					29 01 00 00 00 00 29                /* LTPS Timing Setting */
						c6 01 6e 02 66 00 00 00 00 00
						00 00 00 00 00 00 00 04 19 09
						03 98 01 6e 02 66 00 00 00 00
						00 00 00 00 00 00 00 00 04 19
						09
					29 01 00 00 00 00 0a                /* Panal PIN Control */
						cb e6 e0 87 61 00 00 00 00 c0
					23 01 00 00 00 00 02                /* Panel Interface Control */
						cc 05
					29 01 00 00 00 00 06                /* GPO Control */
						cf 00 00 c1 05 3f
					29 01 00 00 00 00 0f                /* Power Setting(Charge Pump Setting) */
						d0 00 00 19 18 99 9c 1c 01 81
						00 bb 56 4c 01
					29 01 00 00 00 00 1e                /* Power Setting(Swiching regulator Setting) */
						d1 20 00 00 04 08 0c 10 00 00
						00 00 00 3c 04 20 00 00 04 08
						0c 10 00 00 3c 06 40 00 32 31
					29 01 00 00 00 00 1b                /* Power Setting for Internal Power */
						d3 1b 33 bb cc 80 33 33 33 00
						01 00 a0 d8 a0 00 3f 33 33 22
						70 02 37 53 3d bf 11
					29 01 00 00 00 00 03                /* Sequencer  Control */
						d9 20 00
					29 01 00 00 00 00 03                /* Panel synchronous output(1) */
						ec 40 10
					29 01 00 00 00 00 04                /* Panel synchronous output(2) */
						ed 00 00 00
					29 01 00 00 00 00 03                /* Panel synchronous output(3) */
						ee 00 32
					29 01 00 00 00 00 0d                /* Panel synchronous output(4) */
						ef 00 00 00 00 00 00 00 00 00
						00 00 00

					/* Reg(2) CABC */
					29 01 00 00 00 00 08                /* Back Light Control 2(C=3,2 Movie/Still) */
						b9 0f 18 04 40 9f 1f 80
					29 01 00 00 00 00 08                /* Back Light Control 4(C=1 GUI) */
						ba 04 04 04 40 9f 1f d7
					29 01 00 00 00 00 21                /* Color enhancement */
						ca 00 80 80 80 80 80 80 80 08
						20 80 80 0a 4a 37 a0 55 f8 0c
						0c 20 10 3f 3f 00 00 10 10 3f
						3f 3f 3f
					29 01 00 00 00 00 08                /* Back Light Control 6 */
						ce 00 02 00 c1 24 b2 02
					29 01 00 00 00 00 07                /* ContrastOptimize */
						d8 00 80 80 40 42 21
					29 01 00 00 00 00 03                /* Outline Sharpening Control */
						dd 10 8c
					29 01 00 00 00 00 07                /* Test Image Generator */
						de 00 ff 07 10 00 77
					39 01 00 00 00 00 03                /* [DCS] Write_Display_Brightness */
						51 0f ff
					15 01 00 00 00 00 02                /* [DCS] Write_CTRL_Display */
						53 24
					15 01 00 00 00 00 02                /* [DCS] Write_CABC */
						55 01  /* 00:OFF, 01:ON(GUI BA), 02:ON(S/M B9) 03:ON(S/M B9) */
					39 01 00 00 00 00 03                /* [DCS] Write_CABC_Minimum_Brightness */
						5e 00 00

					/* Reg(3) Gamma */
					29 01 00 00 00 00 19                /* Red */
						c7 01 0a 10 1a 28 44 3a 50 5e
						66 6d 75 01 09 10 1a 28 42 38
						4e 5d 65 6c 75
					29 01 00 00 00 00 19                /* Green */
						c8 0d 12 17 1f 2b 44 3a 51 5f
						67 6e 75 0d 12 17 1f 2b 42 37
						4e 5d 66 6d 75
					29 01 00 00 00 00 19                /* Blue */
						c9 1c 20 23 28 32 47 3b 51 61
						6b 70 75 1c 20 23 28 32 45 39
						4e 5f 6a 6f 75

					/* Reg(4) test */
					29 01 00 00 00 00 1a                /*  */
						b8 18 80 18 18 cf 1f 00 0c 10
						5c 10 ac 10 0c 10 da 6d ff ff
						10 67 89 af d6 ff
					29 01 00 00 00 00 04                /*  */
						d2 5c 00 00
					29 01 00 00 00 00 15                /*  */
						d7 84 e0 7f a8 ce 38 fc c1 83
						e7 8f 1f 3c 10 fa c3 0f 04 41
						20

					23 01 00 00 00 00 02 b0 03          /* Manufacture Command Access Protect */
					05 01 00 00 00 00 01 00             /* nop */
					05 01 00 00 00 00 01 00             /* nop */
					];
		qcom,on-cmds-dsi-state = "DSI_LP_MODE";

		qcom,panel-on-post-cmds = [
					05 01 00 00 25 00 01 00             /* wait (nop) */
					05 01 00 00 98 00 01 11             /* exit sleep mode */
					05 01 00 00 16 00 01 29             /* set display on */
					];
		qcom,on-post-cmds-dsi-state = "DSI_LP_MODE";                /* dummy */

		qcom,panel-off-cmds = [
					05 01 00 00 14 00 01 28             /* set display off */
					05 01 00 00 66 00 01 10             /* enter sleep mode */
					];
		qcom,off-cmds-dsi-state = "DSI_HS_MODE";
	};
};
